## conf/layer.conf
```bitbake
# We have a conf and classes directory, add to BBPATH
BBPATH .= ":${LAYERDIR}"

# We have recipes-* directories, add to BBFILES
BBFILES += "${LAYERDIR}/recipes-*/*/*.bb \
            ${LAYERDIR}/recipes-*/*/*.bbappend"

BBFILES += "${LAYERDIR}/recipes-*/*/*/*.bb \
            ${LAYERDIR}/recipes-*/*/*/*.bbappend"
BBFILES += "${LAYERDIR}/recipes-*/*.bb"

BBFILE_COLLECTIONS += "meta-elts"
BBFILE_PATTERN_meta-elts = "^${LAYERDIR}/"
BBFILE_PRIORITY_meta-elts = "6"

LAYERDEPENDS_meta-elts = "core"
LAYERSERIES_COMPAT_meta-elts = "scarthgap"

hostname_pn-base-files = " elts"
MACHINE = "raspberrypi4-64"

IMAGE_INSTALL:append = " os-release"
DISTRO = "ELTS"
DISTRO_NAME = "Embedded Linux Training System"
DISTRO_VERSION = "0.0.1"

EXTRA_IMAGE_FEATURES ?= "debug-tweaks ssh-server-openssh"
IMAGE_INSTALL:append = " gdbserver"
IMAGE_INSTALL:append = " kernel-image kernel-devicetree"
IMAGE_INSTALL:append = " tcpdump iputils "
IMAGE_INSTALL:append = " nano vim"

IMAGE_FSTYPES = "ext4 wic wic.gz"
RPI_USE_U_BOOT = "1"
ENABLE_UART = "1"
ENABLE_I2C = "1"
SDIMG_ROOTFS_TYPE = " ext4"

DISTRO_FEATURES:append = " usrmerge"
DISTRO_FEATURES:append = " systemd"
DISTRO_FEATURES:append = " x11"
DISTRO_FEATURES:append = " desktop"
DISTRO_FEATURES_BACKFILL_CONSIDERED += "sysvinit"
VIRTUAL-RUNTIME_init_manager = "systemd"
VIRTUAL-RUNTIME_initscripts = "systemd-compat-units"

TOOLCHAIN_TARGET_TASK:append = " kernel-devsrc"
IMAGE_INSTALL:append = " kernel-devsrc"

IMAGE_INSTALL:append = " mcpioexpander"
IMAGE_INSTALL:append = " modules-conf"
IMAGE_INSTALL:append = " motd"

SKIP_TFT35_X11_CONFIGS = "1"
IMAGE_INSTALL:append = " lcd-show"
IMAGE_INSTALL:append = " x11-config"

IMAGE_INSTALL:append = " i2c-tools"
IMAGE_INSTALL:append = " spidev-test"
IMAGE_INSTALL:append = " libgpiod libgpiod-tools libiio libcamera"

IMAGE_INSTALL:append = " xserver-xorg xinit xterm openbox matchbox-panel-2 matchbox-desktop"
IMAGE_INSTALL:append = " xf86-video-fbdev"
IMAGE_INSTALL:append = " xf86-video-fbturbo"

IMAGE_INSTALL:append = " packagegroup-core-x11"

RPI_EXTRA_CONFIG = ' \
dtparam=i2c_arm=on \n\
dtparam=spi=on \n\
enable_uart=1 \n\
dtoverlay=tft35a:rotate=90 \n\
dtoverlay=custom-mcp23017 \n'

IMAGE_INSTALL:append = " python3-spidev"

IMAGE_BOOT_FILES:append = " tft35a.dtbo;overlays/tft35a.dtbo"
IMAGE_BOOT_FILES:append = " custom-mcp23017.dtbo;overlays/custom-mcp23017.dtbo"
```
